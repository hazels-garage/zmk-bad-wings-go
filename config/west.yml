## config/west.yml
```yaml
manifest:
  remotes:
    - name: purdeaandrei
      url-base: https://github.com/purdeaandrei
  projects:
    - name: zmk
      remote: purdeaandrei
      revision: f_implement_dehost_driver
      import: app/west.yml
  self:
    path: config
```
